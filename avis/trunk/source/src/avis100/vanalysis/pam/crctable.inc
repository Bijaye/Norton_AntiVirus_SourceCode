;================================================================================================
;
; File name:     CRCtable.inc
;
; Description:   binary virus verification & repair - CRC table.
;
; Statement:     Licensed Materials - Property of IBM
;                (c) Copyright IBM Corp. 1998-1999
;
; Author:        Andy Raybould
;
;                U.S. Government Users Restricted Rights - use,
;                duplication or disclosure restricted by GSA ADP
;                Schedule Contract with IBM Corp.
;
;
;================================================================================================

DD 000000000h, 0362E18AAh, 06C5C3154h, 05A7229FEh, 0D8B862A8h, 0EE967A02h, 0B4E453FCh, 082CA4B56h
DD 0875EDDFAh, 0B170C550h, 0EB02ECAEh, 0DD2CF404h, 05FE6BF52h, 069C8A7F8h, 033BA8E06h, 0059496ACh
DD 03893A35Eh, 00EBDBBF4h, 054CF920Ah, 062E18AA0h, 0E02BC1F6h, 0D605D95Ch, 08C77F0A2h, 0BA59E808h
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DD 0DE17B73Ah, 0E839AF90h, 0B24B866Eh, 084659EC4h, 006AFD592h, 03081CD38h, 06AF3E4C6h, 05CDDFC6Ch
