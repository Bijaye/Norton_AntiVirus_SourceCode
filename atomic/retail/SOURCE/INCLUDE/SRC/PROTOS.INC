;----------------------------------------------------------------------------
; Proto Definition file for ASM files.

WIN_MESSAGE     PROTO FAR PASCAL,Message:WORD,Question:WORD,fStruct:LPSTR

evBypass        PROTO FAR PASCAL,fStruct:LPSTR
evScanBoots     PROTO FAR PASCAL,fStruct:LPSTR
evScanBoot      PROTO FAR PASCAL,fStruct:LPSTR
evScanMBR       PROTO FAR PASCAL,fStruct:LPSTR
evScanExec      PROTO FAR PASCAL,fStruct:LPSTR
evScanOpen      PROTO FAR PASCAL,fStruct:LPSTR
evScanClose     PROTO FAR PASCAL,fStruct:LPSTR
evScanMemory    PROTO FAR PASCAL,fStruct:LPSTR
evScanFBA       PROTO FAR PASCAL,fStruct:LPSTR
evScanPart      PROTO FAR PASCAL,fStruct:LPSTR
evWarmBoot      PROTO FAR PASCAL,fStruct:LPSTR
evWriteDrive    PROTO FAR PASCAL,fStruct:LPSTR
evAccessHard    PROTO FAR PASCAL,fStruct:LPSTR
evAccessFloppy  PROTO FAR PASCAL,fStruct:LPSTR
evWriteHeader   PROTO FAR PASCAL,fStruct:LPSTR
evBootWatch     PROTO FAR PASCAL,fStruct:LPSTR
evFileStop      PROTO FAR PASCAL,fStruct:LPSTR
evWatchTSR      PROTO FAR PASCAL,fStruct:LPSTR
evInoculate     PROTO FAR PASCAL,fStruct:LPSTR
evAttrStop      PROTO FAR PASCAL,fStruct:LPSTR
evReturnPointer PROTO FAR PASCAL,fStruct:LPSTR
evAccessHardBoot PROTO FAR PASCAL,fStruct:LPSTR
evAccessFloppyBoot PROTO FAR PASCAL,fStruct:LPSTR


FIL3_IS_AT              PROTO FAR PASCAL
FIL3_GET_START          PROTO FAR PASCAL
FIL3_OPEN_READ_START	PROTO FAR PASCAL
FIL3_SEEK_FORWARD	    PROTO FAR PASCAL
FIL3_READ_BINARY	    PROTO FAR PASCAL
FIL3_WRITE_BINARY	    PROTO FAR PASCAL
FIL3_CLOSE		        PROTO FAR PASCAL
FIL3_SEEK_FROM_BEGIN	PROTO FAR PASCAL
FIL3_SEEK_BEGIN	        PROTO FAR PASCAL
FIL3_SEEK_END           PROTO FAR PASCAL
FIL3_SEEK_BACKWARD      PROTO FAR PASCAL
FIL3_DUP_HAND  	        PROTO FAR PASCAL
FIL3_GENERIC_REPAIR     PROTO FAR PASCAL
FIL3_GETSTATS           PROTO FAR PASCAL
FIL3_OPEN_RW_CRE_END    PROTO FAR PASCAL
FIL3_OPEN_WRITE_CRE_END PROTO FAR PASCAL
FIL3_WRITE_CRLF         PROTO FAR PASCAL
FIL3_OPEN_RW_START      PROTO FAR PASCAL
FIL3_OPEN_RW_CRE_START  PROTO FAR PASCAL
DAT3_GET_DATE_ASCII     PROTO FAR PASCAL
TIM3_GET_TIME_ASCII     PROTO FAR PASCAL
MEM3_CRC                PROTO FAR PASCAL
WIN_INT25               PROTO FAR PASCAL
WIN_READSECTOR          PROTO FAR PASCAL
WIN_READLONGSECTOR      PROTO FAR PASCAL
WIN_SEGTOSEL	        PROTO FAR PASCAL
WIN_WRITESECTOR         PROTO FAR PASCAL
WIN_FileToPartition     PROTO FAR PASCAL
DOS_INT25               PROTO FAR PASCAL
DOS_READSECTOR          PROTO FAR PASCAL
DOS_READLONGSECTOR      PROTO FAR PASCAL
DOS_SEGTOSEL	        PROTO FAR PASCAL
DOS_WRITESECTOR         PROTO FAR PASCAL
DOS_FileToPartition     PROTO FAR PASCAL
STR3_COPY               PROTO FAR PASCAL
STR3_COMPARE            PROTO FAR PASCAL
STR3_SRCH_END           PROTO FAR PASCAL
STR3_SET_CHAR           PROTO FAR PASCAL
SCR3_GET_VIDEOSEG       PROTO FAR PASCAL

KEY3_SHIFTSTATE         PROTO FAR PASCAL,KeyCheck:WORD

LOG3_DISK               PROTO FAR PASCAL,Message:WORD,wID:WORD,fStruct:LPSTR
LOG3_GENERAL            PROTO FAR PASCAL,wMessage:WORD,wBitID:WORD, fStruct:LPSTR

CMB3_READ               PROTO  FAR PASCAL,
                        uMessage:WORD,Filehandle:WORD,
                        ptrStorage:LPSTR


FMT3_STRING         PROTO FAR PASCAL, fStruct:LPSTR, fSource:LPSTR
FIL3_WR_ASCIIZ      PROTO FAR PASCAL, Handle:WORD, fBuffer:LPSTR
WRITE_FLAGS         PROTO FAR PASCAL, wHandle:WORD, wID:WORD, fTemp:LPSTR
UI_OR_TSR           PROTO FAR PASCAL, wID:WORD, fTemp: LPSTR
INSERT_GUILTY_PROGRAM PROTO FAR PASCAL, fStruct:LPSTR, fDest:LPSTR


REPAIR_ME       PROTO FAR PASCAL,
                VID:WORD,
                Handle:WORD,
                lpBuffer:LPSTR,
                uBuffer:WORD,
                lpData:LPSTR

REP_BVIR        PROTO FAR PASCAL,
                Drive:WORD,
                VID:WORD,
                lpData:LPSTR

